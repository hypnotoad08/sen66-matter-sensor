## sdkconfig.defaults
```kconfig
###############################################################################
# Target & Flash
###############################################################################
CONFIG_IDF_TARGET="esp32s3"
CONFIG_ESPTOOLPY_FLASHMODE_QIO=y
CONFIG_ESPTOOLPY_FLASHSIZE_16MB=y

###############################################################################
# PSRAM (8 MB OPI)
###############################################################################
CONFIG_SPIRAM=y
CONFIG_SPIRAM_MODE_OCT=y
CONFIG_SPIRAM_SPEED_80M=y

###############################################################################
# libsodium
###############################################################################
CONFIG_LIBSODIUM_USE_MBEDTLS_SHA=y

###############################################################################
# NIMBLE (BLE)
###############################################################################
CONFIG_BT_ENABLED=y
CONFIG_BT_NIMBLE_ENABLED=y
CONFIG_BT_NIMBLE_EXT_ADV=n
CONFIG_BT_NIMBLE_HCI_EVT_BUF_SIZE=70

# Use BLE only for commissioning (no Thread)
CONFIG_USE_BLE_ONLY_FOR_COMMISSIONING=y

###############################################################################
# OpenThread (disabled)
###############################################################################
CONFIG_OPENTHREAD_ENABLED=n
#CONFIG_OPENTHREAD_FTD=n
#CONFIG_OPENTHREAD_SRP_CLIENT=n
#CONFIG_OPENTHREAD_DNS_CLIENT=n
#CONFIG_OPENTHREAD_RCP_UART=n

###############################################################################
# ESP-Matter transports & server
###############################################################################
CONFIG_ESP_MATTER_ENABLE_SERVER=y
CONFIG_ESP_MATTER_ENABLE_DATA_MODEL=y
CONFIG_ESP_MATTER_ENABLE_THREAD=n
CONFIG_ESP_MATTER_TRANSPORT_THREAD=n

###############################################################################
# Disable BT reconnection attempts
###############################################################################
CONFIG_BT_NIMBLE_ENABLE_CONN_REATTEMPT=n

###############################################################################
# LWIP IPv6
###############################################################################
CONFIG_LWIP_IPV6_AUTOCONFIG=y
CONFIG_LWIP_IPV6_NUM_ADDRESSES=6
CONFIG_LWIP_HOOK_IP6_ROUTE_DEFAULT=y
CONFIG_LWIP_HOOK_ND6_GET_GW_DEFAULT=y

###############################################################################
# Wi-Fi & SoftAP
###############################################################################
CONFIG_ENABLE_WIFI_AP=n
CONFIG_ESP_WIFI_SOFTAP_SUPPORT=n

###############################################################################
# Partition Table
###############################################################################
CONFIG_PARTITION_TABLE_CUSTOM=y
CONFIG_PARTITION_TABLE_FILENAME="partitions.csv"
CONFIG_PARTITION_TABLE_OFFSET=0x8000

###############################################################################
# CHIP Shell
###############################################################################
CONFIG_ENABLE_CHIP_SHELL=y

###############################################################################
# Button timing
###############################################################################
CONFIG_BUTTON_PERIOD_TIME_MS=20
CONFIG_BUTTON_LONG_PRESS_TIME_MS=5000

###############################################################################
# mbedTLS
###############################################################################
CONFIG_MBEDTLS_HKDF_C=y

###############################################################################
# NVS Namespaces for ESP-Matter
###############################################################################
CONFIG_CHIP_FACTORY_NAMESPACE_PARTITION_LABEL="chip-factory"
CONFIG_CHIP_CONFIG_NAMESPACE_PARTITION_LABEL="chip-config"

###############################################################################
# Clock & Time
###############################################################################
CONFIG_RTC_CLK_SRC_EXT_CRYS=y
CONFIG_ENABLE_SNTP_TIME_SYNC=y

###############################################################################
# Discovery & Commissioning ids
###############################################################################
CONFIG_DEVICE_VENDOR_ID=0xFFF2
CONFIG_DEVICE_PRODUCT_ID=0x66a1
CONFIG_DEVICE_TYPE=0x000C

# Enable some options which reads CD and other basic info from the factory partition
CONFIG_ESP_MATTER_COMMISSIONER_ENABLE=y
CONFIG_FACTORY_COMMISSIONABLE_DATA_PROVIDER=y
CONFIG_FACTORY_PARTITION_DAC_PROVIDER=y
CONFIG_FACTORY_DEVICE_INSTANCE_INFO_PROVIDER=y
CONFIG_ENABLE_ESP32_FACTORY_DATA_PROVIDER=y
CONFIG_ENABLE_ESP32_DEVICE_INSTANCE_INFO_PROVIDER=y
CONFIG_ENABLE_EXTENDED_DISCOVERY=y
CONFIG_ENABLE_COMMISSIONABLE_DEVICE_TYPE=y
```

## sdkconfig.defaults_
```kconfig
# ───── 📦 Flash Configuration ─────
CONFIG_IDF_TARGET="esp32s3"
CONFIG_ESPTOOLPY_FLASHMODE_QIO=y
CONFIG_ESPTOOLPY_FLASHSIZE_16MB=y

# ───── 🧠 PSRAM (Arduino Nano ESP32 has 8MB OPI PSRAM) ─────
CONFIG_SPIRAM=y
CONFIG_SPIRAM_MODE_OCT=y
CONFIG_SPIRAM_SPEED_80M=y

# Partition Table
CONFIG_PARTITION_TABLE_CUSTOM=y
CONFIG_PARTITION_TABLE_FILENAME="partitions.csv"
CONFIG_PARTITION_TABLE_OFFSET=0x8000

# ───── UART RCP Connection ─────
CONFIG_OPENTHREAD_RCP=y
CONFIG_OPENTHREAD_RCP_UART=y
CONFIG_OPENTHREAD_UART_PIN_MANUAL=y
CONFIG_OPENTHREAD_HOST_CONNECTION_MODE_UART=y
CONFIG_OPENTHREAD_UART_PORT=1
CONFIG_OPENTHREAD_UART_PIN_TX=43
CONFIG_OPENTHREAD_UART_PIN_RX=44
CONFIG_OPENTHREAD_UART_BAUDRATE=115200
CONFIG_OPENTHREAD_UART_HARDWARE_FLOW_CONTROL=n



# ───── Thread Web UI + Commissioner + Joiner ─────
CONFIG_OPENTHREAD_BR_START_WEB=y
CONFIG_OPENTHREAD_COMMISSIONER=y
CONFIG_OPENTHREAD_JOINER=y
CONFIG_OPENTHREAD_BORDER_ROUTER=y

# libsodium
CONFIG_LIBSODIUM_USE_MBEDTLS_SHA=y

# ───── RCP Auto-Update Disabled ─────
# CONFIG_OPENTHREAD_BR_AUTO_UPDATE_RCP is not set

# ───── ⏰ RTC Clock ─────
CONFIG_RTC_CLK_SRC_EXT_CRYS=y

# ───── 🧵 Thread / OpenThread ─────
CONFIG_OPENTHREAD_ENABLED=y
CONFIG_OPENTHREAD_SRP_CLIENT=y
CONFIG_OPENTHREAD_DNS_CLIENT=y
CONFIG_OPENTHREAD_LOG_LEVEL_NOTE=y
CONFIG_OPENTHREAD_CLI=n

# ───── 🌐 IPv6 Support ─────
CONFIG_LWIP_IPV6_NUM_ADDRESSES=12
CONFIG_LWIP_MULTICAST_PING=y
CONFIG_LWIP_HOOK_IP6_ROUTE_DEFAULT=y
CONFIG_LWIP_HOOK_ND6_GET_GW_DEFAULT=y

# ───── 📶 Wi-Fi Config ─────
CONFIG_ENABLE_WIFI_STATION=n
CONFIG_ENABLE_WIFI_AP=n
CONFIG_ESP_WIFI_SOFTAP_SUPPORT=n

# ───── 🔐 Crypto / Matter Requirements ─────
CONFIG_MBEDTLS_HKDF_C=y

# ───── 🧠 Freertos Tick Rate ─────
CONFIG_FREERTOS_HZ=1000

# ───── 🔁 Optional OTA Updates ─────
CONFIG_ENABLE_OTA_REQUESTOR=n

# ───── 🧪 Optional Shell for Serial Debugging ─────
CONFIG_ENABLE_CHIP_SHELL=y

# ───── 🔇 Exclude Unused Clusters to Save Space ─────
CONFIG_SUPPORT_APPLICATION_LAUNCHER_CLUSTER=n
CONFIG_SUPPORT_AUDIO_OUTPUT_CLUSTER=n
CONFIG_SUPPORT_MEDIA_INPUT_CLUSTER=n
CONFIG_SUPPORT_MODE_SELECT_CLUSTER=n
CONFIG_SUPPORT_OCCUPANCY_SENSING_CLUSTER=n
CONFIG_SUPPORT_PM1_CONCENTRATION_MEASUREMENT_CLUSTER=n
CONFIG_SUPPORT_PM2_5_CONCENTRATION_MEASUREMENT_CLUSTER=n
CONFIG_SUPPORT_PM10_CONCENTRATION_MEASUREMENT_CLUSTER=n
CONFIG_SUPPORT_TVOC_CONCENTRATION_MEASUREMENT_CLUSTER=n
CONFIG_SUPPORT_NITROGEN_DIOXIDE_CONCENTRATION_MEASUREMENT_CLUSTER=n
CONFIG_SUPPORT_CARBON_DIOXIDE_CONCENTRATION_MEASUREMENT_CLUSTER=n
CONFIG_SUPPORT_USER_LABEL_CLUSTER=n
# ✳️ Enable ones you want (like TVOC, AQI, etc.)

# ───── 🧪 Buttons (only used if you wire one in) ─────
CONFIG_BUTTON_PERIOD_TIME_MS=20
CONFIG_BUTTON_LONG_PRESS_TIME_MS=5000

#
# mbedTLS
#
CONFIG_MBEDTLS_CMAC_C=y
CONFIG_MBEDTLS_SSL_PROTO_DTLS=y
CONFIG_MBEDTLS_KEY_EXCHANGE_ECJPAKE=y
# end of TLS Key Exchange Methods

CONFIG_MBEDTLS_ECJPAKE_C=y
# end of mbedTLS
```
